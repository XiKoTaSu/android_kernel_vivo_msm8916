/* Copyright (c) 2020,the_shahnawaz_sheikh, The Linux Foundation. All rights reserved.
*
* This program is free software; you can redistribute it and/or modify
* it under the terms of the GNU General Public License version 2 and
* only version 2 as published by the Free Software Foundation.
*
* This program is distributed in the hope that it will be useful,
* but WITHOUT ANY WARRANTY; without even the implied warranty of
* MERCHANTABILITY or FITNESS FOR A PARTICULAR PURPOSE.  See the
* GNU General Public License for more details.
*/

&mdss_mdp {

	dsi_nt35510s_fwvga_cmd: qcom,mdss_dsi_nt35510s_fwvga_cmd {
        qcom,mdss-dsi-panel-name = "nt35510s fwvga command mode dsi panel Y23L/Y923L";
        qcom,mdss-dsi-panel-controller = <&mdss_dsi0>;
        qcom,mdss-dsi-panel-type = "dsi_cmd_mode";
        qcom,mdss-dsi-panel-destination = "display_1";
        qcom,mdss-dsi-panel-framerate = <60>;
        qcom,mdss-dsi-virtual-channel-id = <0>;
        qcom,mdss-dsi-stream = <0>;
        qcom,mdss-dsi-panel-id = <2>;
        qcom,mdss-dsi-panel-width = <480>;
        qcom,mdss-dsi-panel-height = <854>;
        qcom,mdss-dsi-h-front-porch = <76>;
        qcom,mdss-dsi-h-back-porch = <76>;
        qcom,mdss-dsi-h-pulse-width = <70>;
        qcom,mdss-dsi-h-sync-skew = <0>;
        qcom,mdss-dsi-v-back-porch = <27>;
        qcom,mdss-dsi-v-front-porch = <6>;
        qcom,mdss-dsi-v-pulse-width = <5>;
        qcom,mdss-dsi-h-left-border = <0>;
        qcom,mdss-dsi-h-right-border = <0>;
        qcom,mdss-dsi-v-top-border = <0>;
        qcom,mdss-dsi-v-bottom-border = <0>;
        qcom,mdss-dsi-bpp = <24>;
        qcom,mdss-dsi-underflow-color = <255>;
        qcom,mdss-dsi-border-color = <0>;
        qcom,mdss-dsi-on-command = [39 01 00 00 00 00 05 ff aa 55 a5 80 39 01 00 00 00 00 02 6f 02 39 01 00 00 00 00 02 f2 08 39 01 00 00 00 00 02 6f 07 39 01 00 00 00 00 02 f7 28 39 01 00 00 00 00 05 ff aa 55 a5 00 39 01 00 00 00 00 06 f0 55 aa 52 08 01 39 01 00 00 00 00 04 b6 34 44 44 39 01 00 00 00 00 04 b0 00 0f 0f 39 01 00 00 00 00 04 b7 24 34 34 39 01 00 00 00 00 04 b1 00 0f 0f 39 01 00 00 00 00 04 b8 05 34 34 39 01 00 00 00 00 02 bf 00 39 01 00 00 00 00 04 b2 03 00 00 39 01 00 00 00 00 04 b9 24 34 34 39 01 00 00 00 00 04 b3 05 05 05 39 01 00 00 00 00 04 ba 14 14 14 39 01 00 00 00 00 04 b5 0c 08 08 39 01 00 00 00 00 04 bc 00 60 00 39 01 00 00 00 00 04 bd 00 60 00 39 01 00 00 00 00 02 be 00 39 01 00 00 00 00 35 d1 00 69 00 8b 00 b2 00 d5 00 e7 01 07 01 20 01 4f 01 77 01 ac 01 d8 02 20 02 5a 02 5c 02 90 02 c8 02 eb 03 17 03 32 03 79 03 9c 03 c0 03 d2 03 e4 03 f6 03 ff 39 01 00 00 00 00 35 d2 01 5c 01 61 01 69 01 73 01 79 01 86 01 91 01 a9 01 c1 01 e5 02 05 02 3e 02 70 02 72 02 a1 02 d8 02 fb 03 2a 03 49 03 88 03 a7 03 c7 03 d7 03 e7 03 f7 03 ff 39 01 00 00 00 00 35 d3 01 30 01 36 01 40 01 4c 01 54 01 63 01 70 01 8c 01 a8 01 d1 01 f5 02 34 02 69 02 6b 02 9c 02 d5 02 fa 03 2e 03 56 03 90 03 ad 03 ca 03 d9 03 e8 03 f7 03 ff 39 01 00 00 00 00 35 d4 00 69 00 8b 00 b2 00 d5 00 e7 01 07 01 20 01 4f 01 77 01 ac 01 d8 02 20 02 5a 02 5c 02 90 02 c8 02 eb 03 17 03 32 03 79 03 9c 03 c0 03 d2 03 e4 03 f6 03 ff 39 01 00 00 00 00 35 d5 01 5c 01 61 01 69 01 73 01 79 01 86 01 91 01 a9 01 c1 01 e5 02 05 02 3e 02 70 02 72 02 a1 02 d8 02 fb 03 2a 03 49 03 88 03 a7 03 c7 03 d7 03 e7 03 f7 03 ff 39 01 00 00 00 00 35 d6 01 30 01 36 01 40 01 4c 01 54 01 63 01 70 01 8c 01 a8 01 d1 01 f5 02 34 02 69 02 6b 02 9c 02 d5 02 fa 03 2e 03 56 03 90 03 ad 03 ca 03 d9 03 e8 03 f7 03 ff 39 01 00 00 00 00 06 f0 55 aa 52 08 00 39 01 00 00 00 00 03 b1 ec 00 39 01 00 00 00 00 02 b5 6b 39 01 00 00 00 00 02 b6 05 39 01 00 00 00 00 03 b7 00 00 39 01 00 00 00 00 05 b8 01 07 07 07 39 01 00 00 00 00 04 bc 00 00 00 39 01 00 00 00 00 06 bd 01 6c 1d 1d 00 39 01 00 00 00 00 06 c9 c0 02 50 90 50 05 01 00 00 78 00 02 11 00 05 01 00 00 14 00 02 29 00];
        qcom,mdss-dsi-off-command = [05 01 00 00 32 00 02 28 00 05 01 00 00 78 00 02 10 00];
        qcom,mdss-dsi-on-command-state = "dsi_lp_mode";
        qcom,mdss-dsi-off-command-state = "dsi_lp_mode";
        qcom,mdss-dsi-h-sync-pulse = <1>;
        qcom,mdss-dsi-traffic-mode = "burst_mode";
        qcom,mdss-dsi-bllp-eof-power-mode;
        qcom,mdss-dsi-bllp-power-mode;
        qcom,mdss-dsi-lane-0-state;
        qcom,mdss-dsi-lane-1-state;
        qcom,mdss-dsi-te-pin-select = <24>;
        qcom,mdss-dsi-wr-mem-start = <44>;
        qcom,mdss-dsi-te-dcs-command = <1>;
        qcom,mdss-dsi-te-check-enable;
        qcom,mdss-dsi-te-using-te-pin;
        qcom,mdss-dsi-panel-timings = <0x831c1200 0x40421828 0x23030400>;
        qcom,mdss-dsi-t-clk-post = <4>;
        qcom,mdss-dsi-t-clk-pre = <27>;
        qcom,mdss-dsi-bl-min-level = <1>;
        qcom,mdss-dsi-bl-max-level = <255>;
        qcom,mdss-dsi-dma-trigger = "trigger_sw";
        qcom,mdss-dsi-mdp-trigger = "none";
        qcom,mdss-dsi-bl-pmic-control-type = "bl_ctrl_pwm";
        qcom,mdss-dsi-reset-sequence = <1 20 0 20 1 20>;
        qcom,mdss-dsi-bl-pmic-pwm-frequency = <25>;
        qcom,mdss-dsi-bl-pmic-bank-select = <0>;
        qcom,mdss-dsi-pwm-gpio = <&pm8916_mpps 4 0>;
        qcom,cont-splash-enabled;
    };
};